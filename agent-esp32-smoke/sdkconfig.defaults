## agent-esp32-smoke/sdkconfig.defaults
```kconfig
# Bootloader log
CONFIG_BOOTLOADER_LOG_LEVEL_INFO=y

# Main task stack
CONFIG_ESP_MAIN_TASK_STACK_SIZE=8192

# HTTP server defaults (used by checkpoint 6)
CONFIG_ESP_HTTPS_OTA_ALLOW_HTTP=y
CONFIG_HTTPD_MAX_REQ_HDR_LEN=2048

# mbedTLS — match agent-esp32 settings
CONFIG_MBEDTLS_CERTIFICATE_BUNDLE=y
CONFIG_MBEDTLS_CERTIFICATE_BUNDLE_DEFAULT_FULL=y
CONFIG_MBEDTLS_DYNAMIC_BUFFER=y
CONFIG_MBEDTLS_DYNAMIC_FREE_PEER_CERT=y
CONFIG_MBEDTLS_DYNAMIC_FREE_CONFIG_DATA=y

# Compiler optimization
CONFIG_COMPILER_OPTIMIZATION_SIZE=y
```

## agent-esp32/sdkconfig.defaults
```kconfig
CONFIG_ESPTOOLPY_FLASHSIZE_16MB=y
CONFIG_SPIRAM=y
CONFIG_SPIRAM_MODE_OCT=y
CONFIG_SPIRAM_USE_MALLOC=y
CONFIG_LOG_DEFAULT_LEVEL=CONFIG_LOG_DEFAULT_LEVEL_INFO
CONFIG_ESP_MAIN_TASK_STACK_SIZE=32768
CONFIG_LWIP_MAX_SOCKETS=16
CONFIG_ESP_CONSOLE_USB_SERIAL_JTAG=y
CONFIG_MDNS_ENABLED=y
CONFIG_MBEDTLS_CERTIFICATE_BUNDLE=y
CONFIG_MBEDTLS_CERTIFICATE_BUNDLE_DEFAULT_FULL=y
CONFIG_ESP_HTTP_CLIENT_ENABLE_HTTPS=y
CONFIG_HTTPD_MAX_REQ_HDR_LEN=1024
CONFIG_HTTPD_MAX_URI_LEN=512
CONFIG_HTTPD_WS_SUPPORT=y
CONFIG_HTTPD_STACK_SIZE=16384
```

## agent/sdkconfig.defaults
```kconfig
# Shared config — all boards
CONFIG_ESPTOOLPY_FLASHSIZE_16MB=y
CONFIG_LOG_DEFAULT_LEVEL=CONFIG_LOG_DEFAULT_LEVEL_INFO
CONFIG_ESP_MAIN_TASK_STACK_SIZE=32768
CONFIG_LWIP_MAX_SOCKETS=16
CONFIG_MDNS_ENABLED=y
CONFIG_MBEDTLS_CERTIFICATE_BUNDLE=y
CONFIG_MBEDTLS_CERTIFICATE_BUNDLE_DEFAULT_CMN=y
# mbedTLS allocates ~30 KB per SSL context. Default goes to internal SRAM,
# which fragments after a few HTTPS calls -> mbedtls_ssl_setup returns
# -0x7F00 (MBEDTLS_ERR_SSL_ALLOC_FAILED). Move to PSRAM and free handshake
# buffers after handshake. Espressif ESP-FAQ recommends both together.
CONFIG_MBEDTLS_EXTERNAL_MEM_ALLOC=y
CONFIG_MBEDTLS_DYNAMIC_BUFFER=y
CONFIG_MBEDTLS_DYNAMIC_FREE_CONFIG_DATA=y
CONFIG_ESP_HTTP_CLIENT_ENABLE_HTTPS=y
CONFIG_HTTPD_MAX_REQ_HDR_LEN=1024
CONFIG_HTTPD_MAX_URI_LEN=512
CONFIG_HTTPD_WS_SUPPORT=y
CONFIG_HTTPD_STACK_SIZE=16384
```
